## CMakeLists.txt
```
# SPDX-License-Identifier: Apache-2.0

cmake_minimum_required(VERSION 3.20.0)
find_package(Zephyr REQUIRED HINTS $ENV{ZEPHYR_BASE})
project(lfrc_calibration_sleep)

target_sources(app PRIVATE src/main.c)
```

## prj.conf
```kconfig
CONFIG_PRINTK=y
CONFIG_BOOT_BANNER=n

# Used to report how many calibrations completed during the sleep.
CONFIG_CLOCK_CONTROL_NRF_CALIBRATION_DEBUG=y

# Reproduce the LF clock request/release transition involved in the failure.
CONFIG_CLOCK_CONTROL_NRF_CALIBRATION_LF_ALWAYS_ON=n
CONFIG_CLOCK_CONTROL_NRF_CALIBRATION_PERIOD=10000
CONFIG_CLOCK_CONTROL_NRF_CALIBRATION_MAX_SKIP=100

# The enabled LFRC devicetree node defaults the Zephyr driver on. The Zephyr
# driver then selects its nrfx backend. These can be stated explicitly, but
# normally should not be necessary:
# CONFIG_CLOCK_CONTROL_NRF_LFRC=y
# CONFIG_NRFX_CLOCK_LFRC=y

# Alternative configurations that avoid the failing clock transition:
# CONFIG_CLOCK_CONTROL_NRF_CALIBRATION_LF_ALWAYS_ON=y
# CONFIG_NRF_GRTC_ALWAYS_ON=y
# CONFIG_NRF_GRTC_TIMER_SOURCE_LFXO=y

# Keep periodic calibration out of the observation window:
# CONFIG_CLOCK_CONTROL_NRF_CALIBRATION_PERIOD=60000

# The original ztest uses this together with its mocked temperature sensor:
# CONFIG_CLOCK_CONTROL_NRF_CALIBRATION_MAX_SKIP=1
```

## boards/nrf7120dk_nrf7120_cpuapp.overlay
```dts
&lfclk {
	k32src = "rc";
	k32src-accuracy-ppm = <250>;
};

&lfrc {
	status = "okay";
};
```

## src/main.c
```c
/*
 * SPDX-License-Identifier: Apache-2.0
 */

#include <hal/nrf_clock.h>
#include <zephyr/device.h>
#include <zephyr/drivers/clock_control/nrf_clock_control.h>
#include <zephyr/kernel.h>

#define CALIBRATION_SLEEP_TIME K_MSEC(150)
#define CALIBRATION_ATTEMPTS   100

int main(void)
{
	// const struct device *const hf_clock = DEVICE_DT_GET_ONE(nordic_nrf_clock_xo);

	// if (!device_is_ready(hf_clock)) {
	// 	printk("HF clock device is not ready\n");
	// 	return 0;
	// }

	for (int attempt = 1; attempt <= CALIBRATION_ATTEMPTS; attempt++) {
		// struct onoff_client hf_client;
		int calibration_count;
		// int err;
		int result;

		while (z_nrf_clock_calibration_is_in_progress()) {
			k_sleep(K_MSEC(1));
		}

		calibration_count = z_nrf_clock_calibration_count();
		printk("Attempt %d: forcing calibration and sleeping\n", attempt);
		z_nrf_clock_calibration_force_start();

		/* Match test_force_calibration(): hold HF on during the sleep. */
		// sys_notify_init_spinwait(&hf_client.notify);
		// err = nrf_clock_control_request(hf_clock, NULL, &hf_client);
		// if (err < 0) {
		// 	printk("HF clock request failed: %d\n", err);
		// 	return 0;
		// }

		// while (sys_notify_fetch_result(&hf_client.notify, &result) != 0) {
		// }
		// if (result < 0) {
		// 	printk("HF clock startup failed: %d\n", result);
		// 	return 0;
		// }

		k_sleep(CALIBRATION_SLEEP_TIME);
		// k_busy_wait(150*1000);

		printk("Attempt %d awake; calibrations: %d\n", attempt,
		       z_nrf_clock_calibration_count() - calibration_count);
		// (void)nrf_clock_control_release(hf_clock, NULL);
	}

	printk("All calibration attempts completed\n");
	return 0;
}
```
